## meta-aspeed-sdk/conf/machine/include/ast-arm-trustzone.inc
```bitbake
MACHINE_FEATURES:append = " ast-arm-trustzone"
MACHINEOVERRIDES .= ":ast-arm-trustzone"
```

## meta-aspeed-sdk/conf/machine/include/ast-mmc.inc
```bitbake
MACHINE_FEATURES:append = " ast-mmc"
MACHINEOVERRIDES .= ":ast-mmc"

# This IMAGE_OVERHEAD_FACTOR allows for a percentage overage of the actual
# image size rather than a fixed extra space, this is space needed for
# initial startup and basic operations.
# IMAGE_OVERHEAD_FACTOR is 1.3 by default in bitbake.conf.
# And the IMAGE_ROOTFS_SIZE is IMAGE_ROOTFS * 1.3 by default.
# The rootfs is a readonly filesystem in openbmc for emmc boot.
# Set IMAGE_OVERHEAD_FACTOR 1 to reduce the code size.
IMAGE_OVERHEAD_FACTOR = "1.0"
```

## meta-aspeed-sdk/conf/machine/include/ast2400-sdk.inc
```bitbake
SOC_FAMILY = "aspeed-g4"
include conf/machine/include/soc-family.inc
require conf/machine/include/aspeed-sdk.inc

SERIAL_CONSOLES ?= "115200;ttyS4"

UBOOT_ENTRYPOINT ?= "0x40000000"
UBOOT_LOADADDRESS ?= "0x40000000"

require conf/machine/include/arm/armv5/tune-arm926ejs.inc
```

## meta-aspeed-sdk/conf/machine/include/ast2500-sdk.inc
```bitbake
SOC_FAMILY = "aspeed-g5"
include conf/machine/include/soc-family.inc
require conf/machine/include/aspeed-sdk.inc

SERIAL_CONSOLES ?= "115200;ttyS4"

DEFAULTTUNE = "arm1176jzs"
UBOOT_ENTRYPOINT ?= "0x80000000"
UBOOT_LOADADDRESS ?= "0x80000000"

require conf/machine/include/arm/armv6/tune-arm1176jz-s.inc
```

## meta-aspeed-sdk/conf/machine/include/ast2600-sdk.inc
```bitbake
SOC_FAMILY = "aspeed-g6"
include conf/machine/include/soc-family.inc
require conf/machine/include/aspeed-sdk.inc

SERIAL_CONSOLES ?= "115200;ttyS4"

DEFAULTTUNE = "armv7ahf-vfpv4d16"
UBOOT_ENTRYPOINT ?= "0x80000000"
UBOOT_LOADADDRESS ?= "0x80000000"

include conf/machine/include/arm/arch-armv7a.inc
```

## meta-aspeed-sdk/conf/machine/include/ast2700-sdk.inc
```bitbake
SOC_FAMILY = "aspeed-g7"
include conf/machine/include/soc-family.inc
require conf/machine/include/aspeed-sdk.inc

DEFAULTTUNE = "cortexa35"

require conf/machine/include/arm/armv8a/tune-cortexa35.inc
require conf/machine/include/ast-arm-trusted-firmware-a.inc

SERIAL_CONSOLES ?= "115200;ttyS12"

UBOOT_FIT_ADDRESS_CELLS ?= "2"
FIT_ADDRESS_CELLS ?= "2"

# kernel and uboot fitimage
UBOOT_ENTRYPOINT ?= "0x4 0x00040000"
UBOOT_LOADADDRESS ?= "0x4 0x00040000"

UBOOT_FIT_ARM_TRUSTED_FIRMWARE_A_LOADADDRESS ?= "0x4 0x30000000"
UBOOT_FIT_ARM_TRUSTED_FIRMWARE_A_ENTRYPOINT ?= "0x4 0x30000000"
UBOOT_FIT_OPTEE_OS_LOADADDRESS ?= "0x4 0x30080000"
UBOOT_FIT_OPTEE_OS_ENTRYPOINT ?= "0x4 0x30080000"

COMPATIBLE_MACHINE:aspeed-g7 = "aspeed-g7"
TFA_PLATFORM = "ast2700"

# optee for BL32.
TFA_SPD = "opteed"

# TFA default build is BL31.
TFA_BUILD_TARGET = "bl31"

# It is a shortcut for "make PLATFORM=aspeed PLATFORM_FLAVOR=ast2700"
OPTEEMACHINE = "aspeed-ast2700"

UBOOT_FIT_ARM_TRUSTED_FIRMWARE_A_IMAGE ?= "${DEPLOY_DIR_IMAGE}/${TFA_BUILD_TARGET}.bin"
UBOOT_FIT_OPTEE_OS_IMAGE ?= "${DEPLOY_DIR_IMAGE}/optee/tee-raw.bin"
```

## meta-aspeed-sdk/meta-ast2500-sdk/conf/machine/ast2500-default-54.conf
```bitbake
require conf/machine/ast2500-default.conf
require conf/machine/include/oldest-kernel-54.inc

PREFERRED_VERSION_linux-aspeed = "5.4.%"
```

## meta-aspeed-sdk/meta-ast2600-sdk/conf/machine/ast2600-a1-54.conf
```bitbake
require conf/machine/ast2600-a1.conf
require conf/machine/include/oldest-kernel-54.inc

KERNEL_DEVICETREE = "aspeed-ast2600a1-evb.dtb"

PREFERRED_VERSION_linux-aspeed = "5.4.%"
```

## meta-aspeed-sdk/meta-ast2600-sdk/conf/machine/ast2600-a1.conf
```bitbake
require conf/machine/ast2600-default.conf

# U-Boot Build Settings
UBOOT_MACHINE = "evb-ast2600a1-spl_defconfig"
UBOOT_DEVICETREE = "ast2600a1-evb"

# Kernel Build Settings
KERNEL_DEVICETREE = "aspeed-ast2600-evb-a1.dtb"
```

## meta-aspeed-sdk/meta-ast2600-sdk/conf/machine/ast2600-a2-54.conf
```bitbake
require conf/machine/ast2600-a2.conf
require conf/machine/include/oldest-kernel-54.inc

KERNEL_DEVICETREE = "aspeed-ast2600a2-evb.dtb"

PREFERRED_VERSION_linux-aspeed = "5.4.%"
```

## meta-aspeed-sdk/meta-ast2600-sdk/conf/machine/ast2600-a2-emmc.conf
```bitbake
require conf/machine/ast2600-emmc.conf

# Kernel Build Settings
KERNEL_DEVICETREE = "aspeed-ast2600-evb-a2.dtb"
```

## meta-aspeed-sdk/meta-ast2600-sdk/conf/machine/ast2600-a2.conf
```bitbake
require conf/machine/ast2600-default.conf

# Kernel Build Settings
KERNEL_DEVICETREE = "aspeed-ast2600-evb-a2.dtb"
```

## meta-aspeed-sdk/meta-ast2600-sdk/conf/machine/ast2600-default-54-tee.conf
```bitbake
require conf/machine/ast2600-default-tee.conf

PREFERRED_VERSION_linux-aspeed = "5.4.%"
```

## meta-aspeed-sdk/meta-ast2600-sdk/conf/machine/ast2600-default-54.conf
```bitbake
require conf/machine/ast2600-default.conf
require conf/machine/include/oldest-kernel-54.inc

PREFERRED_VERSION_linux-aspeed = "5.4.%"
```

## meta-aspeed-sdk/meta-ast2600-sdk/conf/machine/ast2600-default-ecc.conf
```bitbake
require conf/machine/ast2600-default.conf

# U-Boot Build Settings
UBOOT_DEVICETREE = "ast2600-evb-ecc"
```

## meta-aspeed-sdk/meta-ast2600-sdk/conf/machine/ast2600-default-raw.conf
```bitbake
require conf/machine/ast2600-default.conf

# U-Boot Build Settings
UBOOT_DEVICETREE = "ast2600-raw"

# Kernel Build Settings
KERNEL_DEVICETREE = "aspeed-ast2600-raw.dtb"
```

## meta-aspeed-sdk/meta-ast2600-sdk/conf/machine/ast2600-default-secure-515.conf
```bitbake
require conf/machine/ast2600-default-secure.conf

PREFERRED_VERSION_linux-aspeed = "5.15.%"
```

## meta-aspeed-sdk/meta-ast2600-sdk/conf/machine/ast2600-default-secure-tee.conf
```bitbake
require conf/machine/ast2600-default-tee.conf
require conf/machine/include/ast-secure.inc
require conf/machine/include/ast2600-secure-mode.inc
require conf/machine/include/ast2600-secure-customize-gen.inc
```

## meta-aspeed-sdk/meta-ast2600-sdk/conf/machine/ast2600-default-secure.conf
```bitbake
require conf/machine/ast2600-default.conf
require conf/machine/include/ast2600-secure-mode.inc

EXTRA_IMAGEDEPENDS:append = " \
    aspeed-image-genall-secureboot \
    "
```

## meta-aspeed-sdk/meta-ast2600-sdk/conf/machine/ast2600-default-tee.conf
```bitbake
require conf/machine/ast2600-default.conf
require conf/machine/include/ast-optee-os.inc

# U-Boot Build Settings
UBOOT_MACHINE = "evb-ast2600-tee_defconfig"
UBOOT_DEVICETREE = "ast2600-evb-tee"

# Kernel Build Settings
KERNEL_DEVICETREE = "aspeed-ast2600-evb-tee.dtb"
```

## meta-aspeed-sdk/meta-ast2600-sdk/conf/machine/ast2600-ecc-tee.conf
```bitbake
require conf/machine/ast2600-default-tee.conf

# U-Boot Build Settings
UBOOT_DEVICETREE = "ast2600-ecc-tee"
```

## meta-aspeed-sdk/meta-ast2600-sdk/conf/machine/ast2600-ecc.conf
```bitbake
require conf/machine/ast2600-default.conf

# U-Boot Build Settings
UBOOT_MACHINE = "evb-ast2600-spl-ecc_defconfig"
```

## meta-aspeed-sdk/meta-ast2600-sdk/conf/machine/ast2600-emmc-515.conf
```bitbake
require conf/machine/ast2600-emmc.conf

PREFERRED_VERSION_linux-aspeed = "5.15.%"
```

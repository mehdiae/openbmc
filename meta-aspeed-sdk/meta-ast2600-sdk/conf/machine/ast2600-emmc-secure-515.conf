## meta-aspeed-sdk/meta-ast2600-sdk/conf/machine/ast2600-emmc-secure-515.conf
```bitbake
require conf/machine/ast2600-emmc-secure.conf

PREFERRED_VERSION_linux-aspeed = "5.15.%"
```

## meta-aspeed-sdk/meta-ast2600-sdk/conf/machine/ast2600-emmc-secure-tee-515.conf
```bitbake
require conf/machine/ast2600-emmc-secure-tee.conf

PREFERRED_VERSION_linux-aspeed = "5.15.%"
```

## meta-aspeed-sdk/meta-ast2600-sdk/conf/machine/ast2600-emmc-secure-tee.conf
```bitbake
require conf/machine/ast2600-emmc-tee.conf
require conf/machine/include/ast2600-secure-mode.inc
```

## meta-aspeed-sdk/meta-ast2600-sdk/conf/machine/ast2600-emmc-secure.conf
```bitbake
require conf/machine/ast2600-emmc.conf
require conf/machine/include/ast2600-secure-mode.inc
```

## meta-aspeed-sdk/meta-ast2600-sdk/conf/machine/ast2600-emmc-tee-515.conf
```bitbake
require conf/machine/ast2600-emmc-tee.conf

PREFERRED_VERSION_linux-aspeed = "5.15.%"
```

## meta-aspeed-sdk/meta-ast2600-sdk/conf/machine/ast2600-ncsi-tee.conf
```bitbake
require conf/machine/ast2600-default-tee.conf

# U-Boot Build Settings
UBOOT_DEVICETREE = "ast2600-ncsi-tee"

# Kernel Build Settings
KERNEL_DEVICETREE = "aspeed-ast2600-ncsi-tee.dtb"
```

## meta-aspeed-sdk/meta-ast2600-sdk/conf/machine/ast2600-ncsi.conf
```bitbake
require conf/machine/ast2600-default.conf

# U-Boot Build Settings
UBOOT_MACHINE = "evb-ast2600-spl-ncsi_defconfig"
UBOOT_DEVICETREE = "ast2600-ncsi"

# Kernel Build Settings
KERNEL_DEVICETREE = "aspeed-ast2600-ncsi.dtb"
```

## meta-aspeed-sdk/meta-ast2600-sdk/conf/machine/ast2600-usbadp-tee.conf
```bitbake
require conf/machine/ast2600-default-tee.conf

KERNEL_DEVICETREE = "aspeed-ast2600-usbadp-tee.dtb"
```

## meta-aspeed-sdk/meta-ast2600-sdk/conf/machine/include/ast2600-secure-customize-gen.inc
```bitbake
# The following variables can be overridden in local.conf
# Enable aspeed customize secure boot image generation
ASPEED_CUSTOMIZE_GEN_SECURE_IMAGE_ENABLE ?= "1"

# Generate aspeed customize secure boot image
ASPEED_CUSTOMIZE_GEN_SECURE_IMAGE ?= "\
    rsa2048-sha256 \
    rsa2048-sha256-o1 \
    rsa2048-sha256-o2-pub \
    rsa3072-sha384 \
    rsa3072-sha384-o1 \
    rsa3072-sha384-o2-pub \
    rsa4096-sha512 \
    rsa4096-sha512-o1 \
    rsa4096-sha512-o2-pub \
    "
```

## meta-aspeed-sdk/meta-ast2700-pfr/conf/machine/ast2700-dcscm-1700demo.conf
```bitbake
require conf/machine/ast2700-dcscm.conf

# Kernel Build Settings
KERNEL_DEVICETREE = "aspeed/ast2700-dcscm-1700demo.dtb"
```

## meta-aspeed-sdk/meta-ast2700-sdk/conf/machine/ast2700-default-ast1700-evb.conf
```bitbake
require conf/machine/ast2700-default.conf

# Kernel Build Settings
KERNEL_DEVICETREE = "aspeed/ast2700-evb_ast1700-evb.dtb"
```

## meta-aspeed-sdk/meta-ast2700-sdk/conf/machine/ast2700-default-ltpi.conf
```bitbake
require conf/machine/ast2700-default.conf

# Kernel Build Settings
KERNEL_DEVICETREE = "aspeed/ast2700-1700evb.dtb"
```

## meta-aspeed-sdk/meta-ast2700-sdk/conf/machine/ast2700-emmc-tee.conf
```bitbake
require conf/machine/ast2700-emmc.conf
require conf/machine/include/ast-optee-os.inc
```

## meta-aspeed-sdk/meta-ast2700-sdk/conf/machine/ast2700-emmc.conf
```bitbake
require conf/machine/include/ast2700-sdk.inc
require conf/machine/include/ast-mmc.inc
require conf/distro/include/phosphor-mmc.inc
require conf/machine/include/ast-optee-os.inc
require conf/machine/include/obmc-bsp-common.inc

# eMMC Partition Layout File
WKS_FILE = "ast2700-emmc.wks.in"

# BootMCU Build Settings
BOOTMCU_MACHINE = "ibex-ast2700_defconfig"
BOOTMCU_FW_BINARY = "ast2700-ibex-spl.bin"

# U-Boot Build Settings
UBOOT_MACHINE = "evb-ast2700_defconfig"
UBOOT_DEVICETREE = "ast2700-evb"
UBOOT_FITIMAGE_ENABLE = "1"

# Kernel Build Settings
KERNEL_DEVICETREE = "aspeed/ast2700-evb.dtb"
KBUILD_DEFCONFIG = "aspeed_g7_defconfig"

# MMC u-boot and kernel partition size
# Boot partition has 2MB, the first 384KB is reserved for Boot MCU image,
# so u-boot-spl and u-boot-fit has 2048 - 384 = 1664
FLASH_UBOOT_SPL_SIZE="128"
MMC_UBOOT_SIZE = "1664"
MMC_BOOT_PARTITION_SIZE = "13312"

#MACHINE_FEATURES += "\
#        obmc-phosphor-fan-mgmt \
#        obmc-phosphor-chassis-mgmt \
#        obmc-phosphor-flash-mgmt \
#        obmc-host-ipmi \
#        obmc-host-state-mgmt \
#        obmc-chassis-state-mgmt \
#        obmc-bmc-state-mgmt \
#        "
#
#PREFERRED_PROVIDER_virtual/obmc-system-mgmt = "packagegroup-aspeed-obmc"
#PREFERRED_PROVIDER_virtual/obmc-host-ipmi-hw = "phosphor-ipmi-kcs"
#VIRTUAL-RUNTIME_obmc-host-state-manager ?= "x86-power-control"
#VIRTUAL-RUNTIME_obmc-chassis-state-manager ?= "x86-power-control"
#
#aspeed-image-recoveryuart
EXTRA_IMAGEDEPENDS:append = " \
    aspeed-image-emmcboot \
    "
```

## meta-aspeed-sdk/meta-ast2700-sdk/conf/machine/ast2700-fpga-emmc-tee.conf
```bitbake
require conf/machine/ast2700-fpga-emmc.conf
require conf/machine/include/ast-optee-os.inc
```

## meta-aspeed-sdk/meta-ast2700-sdk/conf/machine/ast2700-fpga-tee.conf
```bitbake
require conf/machine/ast2700-fpga.conf
require conf/machine/include/ast-optee-os.inc
```

## meta-aspeed-sdk/meta-ast2700-sdk/conf/machine/ast2700-fpga.conf
```bitbake
require conf/machine/ast2700-default.conf
require conf/machine/include/ast-fpga.inc
```
